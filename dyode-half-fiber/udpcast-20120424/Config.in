## dyode-half-fiber/udpcast-20120424/Config.in
```kconfig
menu "Udpcast"

config UDPRECEIVER
	bool "UDPRECEIVER"
	default y
	help
	  Udpcast receiver

config UDPSENDER
	bool "UDPSENDER"
	default y
	help
	  Udpcast sender

endmenu
```
